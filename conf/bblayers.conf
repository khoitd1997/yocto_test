## conf/bblayers.conf
```bitbake
# POKY_BBLAYERS_CONF_VERSION is increased each time build/conf/bblayers.conf
# changes incompatibly
POKY_BBLAYERS_CONF_VERSION = "2"

BBPATH = "${TOPDIR}"
BBFILES ?= ""

POKY_DIR = "${TOPDIR}/.."

BBLAYERS ?= " \
  ${POKY_DIR}/meta \
  ${POKY_DIR}/meta-poky \
  ${POKY_DIR}/meta-yocto-bsp \
  "
```

## meta-kernel-customization/conf/layer.conf
```bitbake
# We have a conf and classes directory, add to BBPATH
BBPATH .= ":${LAYERDIR}"

# We have recipes-* directories, add to BBFILES
BBFILES += "${LAYERDIR}/recipes-*/*/*.bb \
            ${LAYERDIR}/recipes-*/*/*.bbappend"

BBFILE_COLLECTIONS += "meta-kernel-customization"
BBFILE_PATTERN_meta-kernel-customization = "^${LAYERDIR}/"
BBFILE_PRIORITY_meta-kernel-customization = "6"

LAYERDEPENDS_meta-kernel-customization = "core"
LAYERSERIES_COMPAT_meta-kernel-customization = "hardknott"
```

## user_layers/meta-common-bsp/conf/layer.conf
```bitbake
# We have a conf and classes directory, add to BBPATH
BBPATH .= ":${LAYERDIR}"

# We have recipes-* directories, add to BBFILES
BBFILES += "${LAYERDIR}/recipes-*/*/*.bb \
            ${LAYERDIR}/recipes-*/*/*.bbappend"

BBFILE_COLLECTIONS += "meta-common-bsp"
BBFILE_PATTERN_meta-common-bsp = "^${LAYERDIR}/"
BBFILE_PRIORITY_meta-common-bsp = "6"

LAYERDEPENDS_meta-common-bsp = "core"
LAYERSERIES_COMPAT_meta-common-bsp = "hardknott"
```

## user_layers/meta-fs-overlay/conf/layer.conf
```bitbake
# We have a conf and classes directory, add to BBPATH
BBPATH .= ":${LAYERDIR}"

# We have recipes-* directories, add to BBFILES
BBFILES += "${LAYERDIR}/recipes-*/*/*.bb \
            ${LAYERDIR}/recipes-*/*/*.bbappend"

BBFILE_COLLECTIONS += "meta-fs-overlay"
BBFILE_PATTERN_meta-fs-overlay = "^${LAYERDIR}/"
BBFILE_PRIORITY_meta-fs-overlay = "6"

LAYERDEPENDS_meta-fs-overlay = "core"
LAYERSERIES_COMPAT_meta-fs-overlay = "zeus"
```

## user_layers/meta-my-distro/conf/distro/my-distro.conf
```bitbake
DISTRO = "my-distro"
DISTRO_NAME = "My Distro (My own custom distro)"
DISTRO_VERSION = "3.0.4"
DISTRO_CODENAME = "hardknott"
SDK_VENDOR = "-mydistrosdk"
SDK_VERSION = "${@d.getVar('DISTRO_VERSION').replace('snapshot-${DATE}', 'snapshot')}"

MAINTAINER = "Me <me@my_email.com>"

TARGET_VENDOR = "-mydistro"

LOCALCONF_VERSION = "1"

DISTRO_VERSION[vardepsexclude] = "DATE"
SDK_VERSION[vardepsexclude] = "DATE"

# Override these in poky based distros
MY_DISTRO_DEFAULT_EXTRA_RDEPENDS = "packagegroup-core-boot"
MY_DISTRO_DEFAULT_EXTRA_RRECOMMENDS = "kernel-module-af-packet"

# feature list from:
# default-distrovars.inc
# https://www.yoctoproject.org/docs/current/mega-manual/mega-manual.html#ref-features-distro
# THE LIST FROM THE LINK ABOVE ARE NOT EXHAUSTIVE
DISTRO_FEATURES += " acl xattr largefile ipv4 ipv6 usbhost nfs ldconfig keyboard "

PREFERRED_VERSION_linux-yocto ?= "5.2%"

SDK_NAME = "${DISTRO}-${TCLIBC}-${SDKMACHINE}-${IMAGE_BASENAME}-${TUNE_PKGARCH}-${MACHINE}"
SDKPATH = "/opt/${DISTRO}/${SDK_VERSION}"

DISTRO_EXTRA_RDEPENDS += " ${MY_DISTRO_DEFAULT_EXTRA_RDEPENDS}"
DISTRO_EXTRA_RRECOMMENDS += " ${MY_DISTRO_DEFAULT_EXTRA_RRECOMMENDS}"

MYDISTROQEMUDEPS = "${@bb.utils.contains("INCOMPATIBLE_LICENSE", "GPL-3.0", "", "packagegroup-core-device-devel",d)}"
DISTRO_EXTRA_RDEPENDS_append_qemuarm = " ${MYDISTROQEMUDEPS}"
DISTRO_EXTRA_RDEPENDS_append_qemuarm64 = " ${MYDISTROQEMUDEPS}"
DISTRO_EXTRA_RDEPENDS_append_qemumips = " ${MYDISTROQEMUDEPS}"
DISTRO_EXTRA_RDEPENDS_append_qemuppc = " ${MYDISTROQEMUDEPS}"
DISTRO_EXTRA_RDEPENDS_append_qemux86 = " ${MYDISTROQEMUDEPS}"
DISTRO_EXTRA_RDEPENDS_append_qemux86-64 = " ${MYDISTROQEMUDEPS}"

TCLIBCAPPEND = ""

PREMIRRORS ??= "\
bzr://.*/.*   http://downloads.yoctoproject.org/mirror/sources/ \n \
cvs://.*/.*   http://downloads.yoctoproject.org/mirror/sources/ \n \
git://.*/.*   http://downloads.yoctoproject.org/mirror/sources/ \n \
gitsm://.*/.* http://downloads.yoctoproject.org/mirror/sources/ \n \
hg://.*/.*    http://downloads.yoctoproject.org/mirror/sources/ \n \
osc://.*/.*   http://downloads.yoctoproject.org/mirror/sources/ \n \
p4://.*/.*    http://downloads.yoctoproject.org/mirror/sources/ \n \
svn://.*/.*   http://downloads.yoctoproject.org/mirror/sources/ \n"

SANITY_TESTED_DISTROS ?= " \
            ubuntu-20.04 \n \
            "
#
# OELAYOUT_ABI allows us to notify users when the format of TMPDIR changes in
# an incompatible way. Such changes should usually be detailed in the commit
# that breaks the format and have been previously discussed on the mailing list
# with general agreement from the core team.
#
OELAYOUT_ABI = "12"

# add poky sanity bbclass
INHERIT += "poky-sanity"

# QA check settings - a little stricter than the OE-Core defaults
WARN_TO_ERROR_QA = "already-stripped compile-host-path install-host-path \
                    installed-vs-shipped ldflags pn-overrides rpaths staticdev \
                    unknown-configure-option useless-rpaths"
WARN_QA_remove = "${WARN_TO_ERROR_QA}"
ERROR_QA_append = " ${WARN_TO_ERROR_QA}"

require conf/distro/include/poky-world-exclude.inc
require conf/distro/include/no-static-libs.inc
require conf/distro/include/yocto-uninative.inc
require conf/distro/include/security_flags.inc
INHERIT += "uninative"
```

## user_layers/meta-my-distro/conf/layer.conf
```bitbake
# We have a conf and classes directory, add to BBPATH
BBPATH =. "${LAYERDIR}:"

# We have recipes-* directories, add to BBFILES
BBFILES += "${LAYERDIR}/recipes-*/*/*.bb \
            ${LAYERDIR}/recipes-*/*/*.bbappend"

BBFILE_COLLECTIONS += "meta-my-distro"
BBFILE_PATTERN_meta-my-distro = "^${LAYERDIR}/"
BBFILE_PRIORITY_meta-my-distro = "5"

LAYERSERIES_COMPAT_meta-my-distro = "hardknott"

# This should only be incremented on significant changes that will
# cause compatibility issues with other layers
LAYERVERSION_meta-my-distro = "3"

LAYERDEPENDS_meta-my-distro = "core"

REQUIRED_POKY_BBLAYERS_CONF_VERSION = "2"
```

## user_layers/meta-my-ultra96/conf/layer.conf
```bitbake
# We have a conf and classes directory, add to BBPATH
BBPATH .= ":${LAYERDIR}"

# We have recipes-* directories, add to BBFILES
BBFILES += "${LAYERDIR}/recipes-*/*/*.bb \
            ${LAYERDIR}/recipes-*/*/*.bbappend"

BBFILE_COLLECTIONS += "meta-my-ultra96"
BBFILE_PATTERN_meta-my-ultra96 = "^${LAYERDIR}/"
BBFILE_PRIORITY_meta-my-ultra96 = "6"

LAYERDEPENDS_meta-my-ultra96 = "core"
LAYERSERIES_COMPAT_meta-my-ultra96 = "zeus"
```

## user_layers/meta-my-ultra96/conf/machine/my-ultra96-zynqmp.conf
```bitbake
#@TYPE: Machine
#@NAME: ultra96-zynqmp
#@DESCRIPTION: Machine support for Ultra96 Evaluation Board.
#

require conf/machine/include/soc-zynqmp.inc
require conf/machine/include/machine-xilinx-default.inc
require conf/machine/include/machine-xilinx-qemu.inc
require conf/machine/include/xilinx-board.inc

EXTRA_IMAGEDEPENDS += "libyaml-native python3-cython-native python3-pyyaml-native"

UBOOT_MACHINE ?= "xilinx_zynqmp_virt_defconfig"

MACHINE_ESSENTIAL_EXTRA_RDEPENDS += "device-tree"

# Enable bluetooth and wifi module
# MACHINE_ESSENTIAL_EXTRA_RDEPENDS_append = " linux-firmware-wl18xx linux-firmware-ti-bt-wl180x"

# mipi is not enabled since it requires some unported pl stuff to work
MACHINE_FEATURES = " rtc ext2 ext3 vfat usbhost usbgadget wifi bluetooth "

SPL_BINARY ?= ""

SERIAL_CONSOLES ?= "115200;ttyPS0"

IMAGE_FSTYPES += "ext4 cpio.gz wic"
WKS_FILES ?= "sdboot.wks"

KERNEL_DEVICETREE = "xilinx/zynqmp-zcu100-revC.dtb"

FITIMAGE_KERNEL_COMPRESSION ?= "none"

UBOOT_LOADADDRESS = "0x80000"
UBOOT_ENTRYPOINT = "0x80000"

EXTRA_IMAGEDEPENDS += " \
		arm-trusted-firmware \
		virtual/dtb \
		virtual/boot-bin \
		virtual/bootloader \
        u-boot-zynq-scr \
		"
IMAGE_BOOT_FILES += " \
		boot.scr \
        boot.bin \
        fitImage \
		"
export BOOT_PARTITION_FILES = "${IMAGE_BOOT_FILES}"

SOC_VARIANT = "cg"

YAML_MAIN_MEMORY_CONFIG_my-ultra96-zynqmp ?= "psu_ddr_0"
YAML_CONSOLE_DEVICE_CONFIG_my-ultra96-zynqmp ?= "psu_uart_1"

YAML_SERIAL_CONSOLE_STDIN_my-ultra96-zynqmp ?= "psu_uart_1"
YAML_SERIAL_CONSOLE_STDOUT_my-ultra96-zynqmp ?= "psu_uart_1"

YAML_DT_BOARD_FLAGS_my-ultra96-zynqmp ?= "{BOARD avnet-ultra96-rev1}"

YAML_COMPILER_FLAGS_append_my-ultra96-zynqmp = " -DBOARD_SHUTDOWN_PIN=2 -DBOARD_SHUTDOWN_PIN_STATE=0 "

YAML_COMPILER_FLAGS_append_pn-pmu-firmware = " -DENABLE_MOD_ULTRA96 ${@bb.utils.contains('ULTRA96_VERSION', '2', ' -DULTRA96_VERSION=2 ', ' -DULTRA96_VERSION=1 ', d)}"

PACKAGE_ARCH_pn-linux-xlnx_my-ultra96-zynqmp = "${BOARDVARIANT_ARCH}"

# KERNEL_FEATURES_append = " \
#                             cfg/usb_ethernet.scc \
#                             cfg/usb_host.scc \
# "

# PREFERRED_PROVIDER_virtual/kernel ?= "linux-yocto"
# PREFERRED_VERSION_virtual/kernel ?= "5.10"
# PREFERRED_PROVIDER_virtual/kernel ?= "linux-xlnx"

PREFERRED_PROVIDER_virtual/bootloader ?= "u-boot-xlnx"
# PREFERRED_PROVIDER_virtual/bootloader ?= "u-boot"

PREFERRED_PROVIDER_virtual/boot-bin ?= "xilinx-bootbin"

BIF_BITSTREAM_ATTR = "bitstream"
```

## user_layers/meta-myboard-bsp/conf/machine/my-zcu102-zynqmp.conf
```bitbake
#@TYPE: Machine
#@NAME: zcu102-zynqmp
#@DESCRIPTION: Machine support for ZCU102 Evaluation Board.

require conf/machine/include/soc-zynqmp.inc
require conf/machine/include/machine-xilinx-default.inc
require conf/machine/include/machine-xilinx-qemu.inc

MACHINE_FEATURES = "rtc ext2 ext3 vfat usbhost"

UBOOT_MACHINE ?= "xilinx_zynqmp_virt_defconfig"
# SPL cannot be used by Zynqmp without some patches:
# https://xilinx-wiki.atlassian.net/wiki/spaces/A/pages/18842574/U-Boot+Secondary+Program+Loader
SPL_BINARY ?= ""

# Default SD image build onfiguration, use qemu-sd to pad
IMAGE_CLASSES += "image-types-xilinx-qemu"
IMAGE_FSTYPES += "wic.qemu-sd"
WKS_FILES ?= "sdboot.wks"

SERIAL_CONSOLES ?= "115200;ttyPS0"

KERNEL_DEVICETREE = "xilinx/zynqmp-zcu102-rev1.0.dtb"

EXTRA_IMAGEDEPENDS += " \
		arm-trusted-firmware \
		qemu-devicetrees \
		virtual/boot-bin \
		virtual/bootloader \
        u-boot-zynq-scr \
		"

# support values supported by the "compression" field in kernel part of its file
FITIMAGE_KERNEL_COMPRESSION ?= "none"

# taken from https://xilinx-wiki.atlassian.net/wiki/spaces/A/pages/18842374/U-Boot+Images
UBOOT_LOADADDRESS = "0x80000"
UBOOT_ENTRYPOINT = "0x80000"

IMAGE_BOOT_FILES += " \
		boot.scr \
        fitImage \
		"

SOC_VARIANT = "cg"

YAML_SERIAL_CONSOLE_STDOUT = "psu_uart_0"
YAML_DT_BOARD_FLAGS = "{BOARD zcu102-reva}"

# This machine has a QEMU model, runqemu setup:
QB_MEM = "-m 4096"
QB_OPT_APPEND ?= "-nographic -serial mon:stdio -serial null"
QB_NETWORK_DEVICE = "-net nic -net nic -net nic -net nic,netdev=net0,macaddr=@MAC@"

# Replicate BootROM like behaviour, having loaded SPL and PMU(ROM+FW)
QB_OPT_APPEND_append_qemuboot-xilinx = " \
		-hw-dtb ${DEPLOY_DIR_IMAGE}/qemu-hw-devicetrees/multiarch/zcu102-arm.dtb \
		${@qemu_zynqmp_unhalt(d, True)} \
		-device loader,file=${DEPLOY_DIR_IMAGE}/arm-trusted-firmware.elf,cpu-num=0 \
		-device loader,file=${DEPLOY_DIR_IMAGE}/u-boot.elf \
		-device loader,file=${DEPLOY_DIR_IMAGE}/system.dtb,addr=0x100000 \
		"

# Attach the rootfs disk image to the second SD interface of QEMU (which is SD0)
QB_DEFAULT_FSTYPE_qemuboot-xilinx = "wic.qemu-sd"
QB_OPT_APPEND_append_qemuboot-xilinx = " -boot mode=5"
QB_ROOTFS_OPT_qemuboot-xilinx = " -drive if=sd,index=1,file=@ROOTFS@,format=raw"

QB_PMU_OPT = " \
		-M microblaze-fdt \
		-display none \
		-hw-dtb ${DEPLOY_DIR_IMAGE}/qemu-hw-devicetrees/multiarch/zynqmp-pmu.dtb \
		-kernel ${PMU_ROM} \
		-device loader,file=${PMU_FIRMWARE_DEPLOY_DIR}/${PMU_FIRMWARE_IMAGE_NAME}.elf \
		-device loader,addr=0xfd1a0074,data=0x1011003,data-len=4 \
		-device loader,addr=0xfd1a007C,data=0x1010f03,data-len=4 \
		"
QB_OPT_APPEND_append_qemuboot-xilinx = " -pmu-args '${QB_PMU_OPT}'"

# by default, qemuboot.conf which controls which image is used for booting
# doesn't seem to get rebuilt when things like u-boot script get rebuilt
# so specify them here
do_write_qemuboot_conf[depends] += "u-boot-zynq-scr:do_deploy"

PREFERRED_PROVIDER_virtual/boot-bin = "xilinx-bootbin"
```

## user_layers/meta-myboard-bsp/wic/sdboot.wks
```
# NOTE: Based mostly from sdimage-bootpart.wks
# short-description: Create SD card image with a boot partition
# long-description: Creates a partitioned SD card image. Boot files
# are located in the first vfat partition.

# copy files specified in IMAGE_BOOT_FILES to the boot partition
part /boot --source bootimg-partition --ondisk mmcblk0 --fstype=vfat --label BOOT --active --align 4 --size 1G

part / --source rootfs --ondisk mmcblk0 --fstype=ext4 --label rootfs --align 4
```

## user_layers/meta-user-package/conf/layer.conf
```bitbake
# We have a conf and classes directory, add to BBPATH
BBPATH .= ":${LAYERDIR}"

# We have recipes-* directories, add to BBFILES
BBFILES += "${LAYERDIR}/recipes-*/*/*.bb \
            ${LAYERDIR}/recipes-*/*/*.bbappend"

BBFILE_COLLECTIONS += "meta-user-package"
BBFILE_PATTERN_meta-user-package = "^${LAYERDIR}/"
BBFILE_PRIORITY_meta-user-package = "6"

LAYERDEPENDS_meta-user-package = "core"
LAYERSERIES_COMPAT_meta-user-package = "hardknott"
```
